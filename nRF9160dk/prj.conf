## CMakeLists.txt
```
#
# Copyright (c) 2021 IoTerop
# SPDX-License-Identifier: LicenseRef-BSD-5-Clause-Nordic
#

cmake_minimum_required(VERSION 3.5)



#
find_package(Zephyr REQUIRED HINTS $ENV{ZEPHYR_BASE})

project(iowa_client)

#For evaluation version (from github) 
set(IOWA_SDK_BASE ${CMAKE_CURRENT_SOURCE_DIR}/iowa-sdk/iowa)

FILE(GLOB_RECURSE iowa_sources ${IOWA_SDK_BASE}/src/*.c)

# NORDIC SDK APP START
target_sources( app PRIVATE 
    src/main.c
    src/client_platform.c
    ${iowa_sources})

zephyr_include_directories(
    src
    ${IOWA_SDK_BASE}/include
    ${IOWA_SDK_BASE}/include/objects
    ${IOWA_SDK_BASE}/src/coap
    ${IOWA_SDK_BASE}/src/comm
    ${IOWA_SDK_BASE}/src/core
    ${IOWA_SDK_BASE}/src/data
    ${IOWA_SDK_BASE}/src/logger
    ${IOWA_SDK_BASE}/src/lwm2m
    ${IOWA_SDK_BASE}/src/misc
    ${IOWA_SDK_BASE}/src/objects
    ${IOWA_SDK_BASE}/src/oscore
    ${IOWA_SDK_BASE}/src/security
)
            
```

## Kconfig
```
#
# Copyright (c) 2021 IoTerop
#
# SPDX-License-Identifier: LicenseRef-BSD-5-Clause-Nordic
#

menu "IOWA sample settings"

config IOWA_SERVER_URI
	string "IOWA server address"
	default "coap://iowa-server.ioterop.com"

config IOWA_SERVER_PORT
	string "IOWA server port"
	default "5683"

config IOWA_SERVER_SHORT_ID
	int "IOWA server short id"
	default 1234

config IOWA_SERVER_LIFETIME
	int "IOWA server lifetime"
	default 50

config IOWA_DEVICE_NAME
	string "IOWA device endpoint name"
	default "IOWA_nrf9160DK_Client"

config IOWA_PSK_IDENTITY
	string "IOWA PSK identity"
	default "MyIdentity"

config IOWA_PSK_KEY
	string "IOWA PSK key"
	default "123456"

config IOWA_BOARD_TLS_TAG
	int "IOWA Board TLS tag"
	default 280234110

config MODEM_PSM_ENABLE
	bool "Enable LTE Power Saving Mode"
	default n

config MODEM_EDRX_ENABLE
	bool "Enable LTE enhanced Discontinuous Reception"

config MODEM_RAI_ENABLE
	bool "Enable LTE Release Assistance Indication"

endmenu

module = IOWA
module-str = IOWA sample
source "${ZEPHYR_BASE}/subsys/logging/Kconfig.template.log_config"

menu "Zephyr Kernel"
source "Kconfig.zephyr"
endmenu
```

## sample.yaml
```
sample:
  name: IOWA client sample
tests:
  samples.nrf9160.iowa_client:
    build_only: true
    integration_platforms:
      - nrf9160dk_nrf9160_ns
    platform_allow: nrf9160dk_nrf9160_ns
    tags: ci_build
```

## prj.conf
```kconfig
#
# Copyright (c) 2021 IoTerop
#
# SPDX-License-Identifier: LicenseRef-BSD-5-Clause-Nordic
#

# MBEDTLS
CONFIG_MBEDTLS=y
CONFIG_MBEDTLS_TLS_VERSION_1_2=n
CONFIG_MBEDTLS_DTLS=y
CONFIG_MBEDTLS_BUILTIN=y

# MBEDTLS settings
CONFIG_MBEDTLS_CIPHER_CCM_ENABLED=n
# Disable RSA, we don't parse certs: saves flash/memory
CONFIG_MBEDTLS_KEY_EXCHANGE_RSA_ENABLED=n
# Enable PSK instead
CONFIG_MBEDTLS_KEY_EXCHANGE_PSK_ENABLED=y
#CONFIG_NET_SOCKETS_TLS_MAX_CONTEXTS=4

# General config
CONFIG_NEWLIB_LIBC=y
CONFIG_NEWLIB_LIBC_FLOAT_PRINTF=y
CONFIG_NCS_SAMPLES_DEFAULTS=y
CONFIG_SERIAL=y

# Network
CONFIG_NETWORKING=y
CONFIG_NET_NATIVE=n
CONFIG_NET_SOCKETS=y
CONFIG_NET_SOCKETS_OFFLOAD=y
CONFIG_NET_SOCKETS_POSIX_NAMES=y

# LTE link control
CONFIG_LTE_LINK_CONTROL=y
CONFIG_LTE_AUTO_INIT_AND_CONNECT=n

# BSD library
CONFIG_BSD_LIBRARY=y

# Heap and stacks
CONFIG_HEAP_MEM_POOL_SIZE=4096
CONFIG_MAIN_STACK_SIZE=4096
CONFIG_SYSTEM_WORKQUEUE_STACK_SIZE=2048

# LTE parameters
## Network Mode / LTE category
CONFIG_LTE_NETWORK_MODE_LTE_M=n

#nRF9160 features
CONFIG_MODEM_KEY_MGMT=y

## PSM
CONFIG_MODEM_PSM_ENABLE=n
CONFIG_LTE_PSM_REQ_RPTAU="00100001"
CONFIG_LTE_PSM_REQ_RAT="00000000"

## eDRX
CONFIG_MODEM_EDRX_ENABLE=n
CONFIG_LTE_EDRX_REQ_VALUE="1001"

## RAI
CONFIG_MODEM_RAI_ENABLE=n
CONFIG_LTE_RAI_REQ_VALUE="4"

CONFIG_UART_INTERRUPT_DRIVEN=y
CONFIG_AT_HOST_LIBRARY=y
```

## src/main.c
```c
/**********************************************
 *
 * Copyright (c) 2016-2021 IoTerop.
 * All rights reserved.
 *
 * This program and the accompanying materials
 * are made available under the terms of
 * IoTerop’s IOWA License (LICENSE.TXT) which
 * accompany this distribution.
 *
 **********************************************/

/**************************************************
 *
 * This is a very simple LwM2M Client demonstrating
 * IOWA ease-of-use over Nordic nrf9160DK
 *
 **************************************************/

#include "iowa_client.h"
#include "iowa_ipso.h"

#include <modem/lte_lc.h>
#include <net/socket.h>
#include <stdio.h>
#include <zephyr.h>

#include <modem/modem_key_mgmt.h>
#include <net/tls_credentials.h>

#if defined(EXIST_IN_KCONFIG)
// Theses settings are defined in KConfig file
// On iowa-server.ioterop.com, the secure port is on 5684 (non-secure: 5683)
#define CONFIG_IOWA_SERVER_URI "coap://iowa-server.ioterop.com"
#define CONFIG_IOWA_SERVER_PORT "5684"

#define CONFIG_IOWA_DEVICE_NAME "IOWA_nrf9160DK_Client"

#define CONFIG_IOWA_SERVER_SHORT_ID 1234
#define CONFIG_IOWA_SERVER_LIFETIME 50

#define CONFIG_IOWA_PSK_IDENTITY  "MyIdentity"
#define CONFIG_IOWA_PSK_KEY       "123456"
#define CONFIG_IOWA_BOARD_TLS_TAG 280234110

#endif


// LwM2M Server details
#define SERVER_SHORT_ID CONFIG_IOWA_SERVER_SHORT_ID //default: 1234
#define SERVER_LIFETIME CONFIG_IOWA_SERVER_LIFETIME //default: 50
#define SERVER_URI CONFIG_IOWA_SERVER_URI ":" CONFIG_IOWA_SERVER_PORT

// Change the name for non secure device
#if defined(CONFIG_MBEDTLS)
  #define ENDPOINT_NAME CONFIG_IOWA_DEVICE_NAME
#else
  #define ENDPOINT_NAME CONFIG_IOWA_DEVICE_NAME "_NoSec"  // add suffix to device name
#endif

static char client_identity[] = CONFIG_IOWA_PSK_IDENTITY ;
static char client_psk[] = CONFIG_IOWA_PSK_KEY;       //Not in base64 

// proto - client_platform.c
extern void *get_platform_data();

// a structure to store data for the measure task
typedef struct
{
    iowa_context_t iowaContext;
    iowa_sensor_t voltSensorId;
} measure_data_t;
measure_data_t measureP;

#define THREAD_STACK_SIZE KB(1)
#define THREAD_PRIORITY K_PRIO_COOP(CONFIG_NUM_COOP_PRIORITIES - 1) //K_LOWEST_APPLICATION_THREAD_PRIO

static K_KERNEL_STACK_DEFINE(measure_thread_stack, THREAD_STACK_SIZE);
static struct k_thread measure_thread_data;
static k_tid_t measure_thread_id;

// notif. for cellular
K_SEM_DEFINE(lte_connected, 0, 1);

//#if defined(CONFIG_BSD_LIBRARY)
/* --------------------------------------------------------------- 
*/
static void lte_handler(const struct lte_lc_evt *const evt) {
    switch (evt->type) {
    case LTE_LC_EVT_NW_REG_STATUS:
        if ((evt->nw_reg_status != LTE_LC_NW_REG_REGISTERED_HOME) &&
            (evt->nw_reg_status != LTE_LC_NW_REG_REGISTERED_ROAMING)) {
            break;
        }

        printk("Network registration status: %s\n",
            evt->nw_reg_status == LTE_LC_NW_REG_REGISTERED_HOME ? "Connected - home network" : "Connected - roaming\n");
        k_sem_give(&lte_connected);
        break;
    case LTE_LC_EVT_PSM_UPDATE:
        printk("PSM parameter update: TAU: %d, Active time: %d\n",
            evt->psm_cfg.tau, evt->psm_cfg.active_time);
        break;
    case LTE_LC_EVT_EDRX_UPDATE: {
        char log_buf[60];
        ssize_t len;

        len = snprintf(log_buf, sizeof(log_buf),
            "eDRX parameter update: eDRX: %f, PTW: %f\n",
            evt->edrx_cfg.edrx, evt->edrx_cfg.ptw);
        if (len > 0) {
            printk("%s\n", log_buf);
        }
        break;
    }
    case LTE_LC_EVT_RRC_UPDATE:
        printk("RRC mode: %s\n",
            evt->rrc_mode == LTE_LC_RRC_MODE_CONNECTED ? "Connected" : "Idle\n");
        break;
    case LTE_LC_EVT_CELL_UPDATE:
        printk("LTE cell changed: Cell ID: %d, Tracking area: %d\n",
            evt->cell.id, evt->cell.tac);
        break;
    default:
        break;
    }
}

/* --------------------------------------------------------------- 
*/
static int configure_low_power(void) {
    int err;

#if defined(CONFIG_MODEM_PSM_ENABLE)
    /** Power Saving Mode */
    err = lte_lc_psm_req(true);
    if (err) {
        printk("lte_lc_psm_req, error: %d\n", err);
    }
#else
    err = lte_lc_psm_req(false);
    if (err) {
        printk("lte_lc_psm_req, error: %d\n", err);
    }
#endif

#if defined(CONFIG_MODEM_EDRX_ENABLE)
    /** enhanced Discontinuous Reception */
    err = lte_lc_edrx_req(true);
    if (err) {
        printk("lte_lc_edrx_req, error: %d\n", err);
    }
#else
    err = lte_lc_edrx_req(false);
    if (err) {
        printk("lte_lc_edrx_req, error: %d\n", err);
    }
#endif

#if defined(CONFIG_MODEM_RAI_ENABLE)
    /** Release Assistance Indication  */
    err = lte_lc_rai_req(true);
    if (err) {
        printk("lte_lc_rai_req, error: %d\n", err);
    }
#endif

    return err;
}

/* --------------------------------------------------------------- 
*/
static int modem_configure(void) {
    int err;

    if (IS_ENABLED(CONFIG_LTE_AUTO_INIT_AND_CONNECT)) {
        /* Do nothing, modem is already configured and LTE connected. */
    } else {
        err = lte_lc_init_and_connect_async(lte_handler);
        if (err) {
            printk("Modem configuration, error: %d\n", err);
            return err;
        }
    }
}
//#endif


/* ----------------------------------------------------
 * handle the result notification
*/
#ifndef CONFIG_IOWA_EVAL_VERSION 
static void prv_sendResultCb(uint32_t shortId,
    iowa_dm_operation_t operation,
    iowa_status_t status,
    iowa_response_content_t *contentP,
    void *userDataP,
    iowa_context_t contextP) {
    (void)shortId;
    (void)contextP;
    (void)contentP;
    (void)userDataP;

    if (operation == IOWA_DM_DATA_PUSH) {
        printk("\tprv_sendResultCb():Send operation occurred: %u.%02u\n", (status & 0xFF) >> 5, (status & 0x1F));
    }
}
#endif
/* ----------------------------------------------------
*/
static void send_measure_fn(void) {
    iowa_status_t result;
    iowa_sensor_uri_t sensorUri;
    
    sensorUri.id = measureP.voltSensorId;
    sensorUri.resourceId = IOWA_LWM2M_ID_ALL;

    while (1) {
        if (measureP.voltSensorId > 0) {
            // Example: Update the sensor values with a random value
            float newValue = (float)(rand() % 100);
            result = iowa_client_IPSO_update_value(measureP.iowaContext, measureP.voltSensorId, newValue);
            k_yield();
            if (result != IOWA_COAP_NO_ERROR) {
                printk("Updating the voltage sensor value failed (%u.%02u).\n", (result & 0xFF) >> 5, (result & 0x1F));
            }
            printk("\n===> Thread: Voltage sensor value changed to %d.\n", (int)newValue);
        }
        k_msleep(1000);
    }
}

/* --------------------------------------------------------------- 
*/
void main(void) {
    int err;
    iowa_context_t iowaH;
    iowa_status_t result;
    iowa_device_info_t devInfo;
    void *platformDataP;

    printk("**************************************\n");
    printk("** Iowa sample client for nrf9160DK **\n");
    printk("** (c)IoTerop 2021                  **\n");
    printk("**************************************\n");
    printk("Server:  %s\n", SERVER_URI);
    printk("Endpoint Name: %s\n", ENDPOINT_NAME);

    printk("Connecting celullar network...\n");
    measureP.voltSensorId = 0;

#if defined(CONFIG_BSD_LIBRARY)
    err = configure_low_power();
    if (err) {
        printk("Unable to set low power configuration, error: %d\n",
            err);
    }
#endif
    modem_configure();

    k_sem_take(&lte_connected, K_FOREVER);


    // Application specific : initialize abstraction layer functions
    printk("Start IOWA lwm2m stack\n");
#if defined(CONFIG_MBEDTLS)
    printk("MBEDTLS version\n");
#endif

    platformDataP = get_platform_data();
    if (platformDataP == NULL) {
        printk("Error initializing platform functions.\n");
        return;
    }

    // Initialize the IOWA stack.
    iowaH = iowa_init(platformDataP);
    if (iowaH == NULL) {
        printk("IOWA context initialization failed.\n");
        goto cleanup;
    }

    // Save iowa context
    measureP.iowaContext = iowaH;

    // Start "send measure" thread
    measure_thread_id = k_thread_create(&measure_thread_data,
        &measure_thread_stack[0],
        K_KERNEL_STACK_SIZEOF(measure_thread_stack),
        (k_thread_entry_t)send_measure_fn,
        NULL, NULL, NULL,
        /* Lowest priority cooperative thread */
        THREAD_PRIORITY, 0, K_NO_WAIT);

    // Configure the LwM2M Client
    memset(&devInfo, 0, sizeof(iowa_device_info_t));
    devInfo.manufacturer = "IoTerop";
    devInfo.deviceType = "IOWA nrf9160DK basic sample";
    devInfo.modelNumber = "nrf9160DK-001";
    result = iowa_client_configure(iowaH, ENDPOINT_NAME, &devInfo, NULL);

    if (result != IOWA_COAP_NO_ERROR) {
        printk("IOWA Client configuration failed (%u.%02u).\n", (result & 0xFF) >> 5, (result & 0x1F));
        goto cleanup;
    }

    // Add a LwM2M Server to connect to
    result = iowa_client_add_server(iowaH, SERVER_SHORT_ID, SERVER_URI, SERVER_LIFETIME, 0, IOWA_SEC_NONE);  
    if (result != IOWA_COAP_NO_ERROR) {
        printk("Adding a server failed (%u.%02u).\n", (result & 0xFF) >> 5, (result & 0x1F));
        goto cleanup;
    }

    // Add an IPSO voltage sensor
    result = iowa_client_IPSO_add_sensor(iowaH, IOWA_IPSO_VOLTAGE, 12.0, "V", "Test DC", 0.0, 24.0, &measureP.voltSensorId);
    if (result != IOWA_COAP_NO_ERROR) {
        printk("Adding a sensor failed (%u.%02u).\n", (result & 0xFF) >> 5, (result & 0x1F));
        goto cleanup;
    }

    //IOWA stack runs for 2 minutes
    result = iowa_step(iowaH, 240);
    if (result != IOWA_COAP_NO_ERROR) {
        printk("iowa_step failed with (%u.%02u).\n", (result & 0xFF) >> 5, (result & 0x1F));
        goto cleanup;
    }

cleanup:
    printk("Leaving IOWA.\n");

    k_thread_abort(measure_thread_id);

    iowa_client_remove_server(iowaH, SERVER_SHORT_ID);
    iowa_close(iowaH);
}
```

## src/client_platform.c
```c
/**********************************************
*
* Copyright (c) 2016-2021 IoTerop.
* All rights reserved.
*
**********************************************/

/**********************************************
 *
 * This file implements the IOWA system
 * abstraction functions for Linux and Windows.
 *
 * This is tailored for the LwM2M Client on nrf9160DK
 * TODO: TCP support to add
 *
 **********************************************/

// IOWA header
#include "iowa_platform.h"

#include <zephyr.h>
#include <stdio.h>

#include <modem/lte_lc.h>
#include <net/socket.h>
#include <errno.h>

#include <modem/modem_key_mgmt.h>
#include <net/tls_credentials.h>

typedef struct
{
    // a mutex for iowa_system_mutex_* functions
    struct k_mutex mutex;

    // a socket to interrupt the select()
    int sysSocket;
} sample_platform_data_t;

// This function creates a self-connected UDP socket which only purpose
// is to interrupt the select
static int prv_createSysSocket()
{
    int sysSock;
    struct sockaddr_in sysAddr;

    sysSock = socket(AF_INET, SOCK_DGRAM, IPPROTO_UDP);
    if (sysSock  < 0)
    {
       printk("prv_createSysSocket: Failed to create TCP/UDP socket: %d\n", errno);
       return -1;
    }

    memset((char *)& sysAddr, 0, sizeof(sysAddr));

    sysAddr.sin_family = AF_INET;
    sysAddr.sin_port = htons(60000);
    sysAddr.sin_addr.s_addr =  htonl((127 << 24) | (0 << 16) | (0 << 8) | 1);
    
    //bind socket to port
    if (bind(sysSock, (struct sockaddr *) &sysAddr, sizeof(sysAddr)) == -1)
    {
        printk("Bind error\n");
        goto error;
    }

    return sysSock;

error:
    close(sysSock);

    return -1;
}

void free_platform_data(void *userData)
{
    sample_platform_data_t *dataP;

    dataP = (sample_platform_data_t *)userData;

    if (dataP->sysSocket != -1)
    {
        close(dataP->sysSocket);
    }
    k_free(dataP);
}

// This function initializes data used in the system abstraction functions.
// The allocated stucture will be past as userData to the other functions in this file.
void * get_platform_data()
{
    sample_platform_data_t *dataP;
    dataP = (sample_platform_data_t *)k_malloc(sizeof(sample_platform_data_t));
    if (dataP == NULL)
    {
        return NULL;
    }

    if (k_mutex_init(&(dataP->mutex)) != 0)
    {
        goto error;
    }

    dataP->sysSocket = prv_createSysSocket();
    if (dataP->sysSocket == -1)
    {
        goto error;
    }

    return (void *)dataP;

error:
    free_platform_data(dataP);
    return NULL;
}

// We bind this function directly to malloc().
void * iowa_system_malloc(size_t size)
{
    return k_malloc(size);
}

// We bind this function directly to free().
void iowa_system_free(void *pointer)
{
    k_free(pointer);
}

// We return the number of seconds since Epoch.
int32_t iowa_system_gettime(void)
{
    return (int32_t) (k_uptime_get() / 1000);
}

// We fake a reboot by exiting the application.
void iowa_system_reboot(void *userData)
{
    (void)userData;

    fprintf(stdout, "\n\tFaking a reboot.\r\n\n");
    exit(0);
}

// Traces are output on stderr.
void iowa_system_trace(const char *format,
                       va_list varArgs)
{
    vprintf(format, varArgs);    
}

// For POSIX platforms, we use BSD sockets.
// The socket number (incremented by 1, 0 being a valid socket number) is cast as a void *.
static void * prv_sockToPointer(int sock)
{
    void *pointer;

    pointer = NULL;
    sock += 1;

    memcpy(&pointer, &sock, sizeof(int));

    return pointer;
}

static int prv_pointerToSock(void *pointer)
{
    int sock;

    memcpy(&sock, &pointer, sizeof(int));

    return sock - 1;
}

#if defined(CONFIG_MBEDTLS)
/**@brief Add socket credentials according to security tag */
static int socket_sectag_set(int fd, int sec_tag)
{
    int err;
    int verify;
    sec_tag_t sec_tag_list[] = {sec_tag};

    enum
    {
        NONE = 0,
        OPTIONAL = 1,
        REQUIRED = 2,
    };

    verify = NONE;

    err = setsockopt(fd, SOL_TLS, TLS_PEER_VERIFY, &verify, sizeof(verify));
    if (err)
    {
        printk("Failed to setup peer verification, errno %d\n", errno);
        return -errno;
    }

    printk("Setting up TLS credentials, tag %d\n", sec_tag);
    err = setsockopt(fd, SOL_TLS, TLS_SEC_TAG_LIST, sec_tag_list,
                     sizeof(sec_tag_t) * ARRAY_SIZE(sec_tag_list));
    if (err)
    {
        printk("Failed to setup socket security tag, errno %d\n", errno);
        return -errno;
    }

    return 0;
}

#endif //(CONFIG_MBEDTLS)


// We consider only UDP connections.
// We open an UDP socket binded to the the remote address.
void * iowa_system_connection_open(iowa_connection_type_t type,
                                   char *hostname,
                                   char *port,
                                   void *userData)
{
#ifdef _WIN32
    struct WSAData wd;
#endif
    struct addrinfo hints;
    struct addrinfo *servinfo = NULL;
    struct addrinfo *p;
    int s;
#if defined(CONFIG_MBEDTLS)
    int err;
#endif

    (void)userData;

    // let's consider only UDP connection in this sample
    if (type != IOWA_CONN_DATAGRAM)
    {
        return NULL;
    }

    memset(&hints, 0, sizeof(hints));
    hints.ai_family = AF_INET;
    hints.ai_socktype = SOCK_DGRAM;

    if (0 != getaddrinfo(hostname, port, &hints, &servinfo)
        || servinfo == NULL)
    {
        return NULL;
    }

    // we test the various addresses
    s = -1;
    for (p = servinfo; p != NULL && s == -1; p = p->ai_next)
    {
#if defined(CONFIG_MBEDTLS)
      p->ai_protocol = IPPROTO_DTLS_1_2;
#else
      p->ai_protocol = IPPROTO_UDP;
#endif
        s = socket(p->ai_family, p->ai_socktype, p->ai_protocol);
        if (s >= 0)
        {
#if defined(CONFIG_MBEDTLS)
          err = socket_sectag_set(s, CONFIG_IOWA_BOARD_TLS_TAG);
          if (err)
          {
            close(s);
            s = -1;       
          }
          else 
#endif
            if (-1 == connect(s, p->ai_addr, p->ai_addrlen))
            {
                close(s);
                s = -1;
            }
        }
    }

    if (NULL != servinfo)
    {
        freeaddrinfo(servinfo);
    }

    if (s < 0)
    {
        // failure
        return NULL;
    }

    return prv_sockToPointer(s);
}

// Since the socket is binded, we can use send() directly.
int iowa_system_connection_send(void *connP,
                                uint8_t *buffer,
                                size_t length,
                                void *userData)
{
    int nbSent;
    int sock;

    (void)userData;

    sock = prv_pointerToSock(connP);

    nbSent = send(sock, buffer, length, 0);

    return nbSent;
}

// Since the socket is binded, it receives datagrams only from the binded address.
int iowa_system_connection_recv(void *connP,
                                uint8_t *buffer,
                                size_t length,
                                void *userData)
{
    int numBytes;
    int sock;

    (void)userData;

    sock = prv_pointerToSock(connP);

    numBytes = recv(sock, buffer, length, 0);

    return numBytes;
}

// In this function, we use select on the sockets provided by IOWA
// and on the sample_platform_data_t::pipeArray to be able to
// interrupt the select() if required.
int iowa_system_connection_select(void **connArray,
                                  size_t connCount,
                                  int32_t timeout,
                                  void *userData)
{
    struct timeval tv;
    fd_set readfds;
    size_t i;
    int result;
    sample_platform_data_t *dataP;
    int maxFd;
    int fd;

    dataP = (sample_platform_data_t *)userData;

    tv.tv_sec = timeout;
    tv.tv_usec = 0;

    FD_ZERO(&readfds);

    // we add an dummy socket to be able to interrupt the select()
    FD_SET(dataP->sysSocket, &readfds);
    maxFd = dataP->sysSocket;

    // Then the sockets requested by IOWA
    for (i = 0; i < connCount; i++)
    {
        fd = prv_pointerToSock(connArray[i]);
        FD_SET(fd, &readfds);
        if (fd > maxFd)
        {
            maxFd = fd;
        }
    }

    result = select(maxFd + 1, &readfds, NULL, NULL, &tv);

    if (result > 0)
    {
        for (i = 0; i < connCount; i++)
        {
            if (!FD_ISSET(prv_pointerToSock(connArray[i]), &readfds))
            {
                connArray[i] = NULL;
            }
        }
        if (FD_ISSET(dataP->sysSocket, &readfds))
        {
            uint8_t buffer[1];
            struct sockaddr peerAddr;
            socklen_t peerAddrLength;

            result--;
            (void)recvfrom(dataP->sysSocket, buffer, 1, 0, &peerAddr, &peerAddrLength);
        }
    }
    else if (result < 0)
    {
        if (errno == EINTR)
        {
            result = 0;
        }
    }

    return result;
}

void iowa_system_connection_close(void *connP,
                                  void *userData)
{
    int sock;

    (void)userData;

    sock = prv_pointerToSock(connP);

    close(sock);
}

// To make the call to select() in iowa_system_connection_select() stops,
// we write data to the sysSocket if it's empty.
void iowa_system_connection_interrupt_select(void *userData)
{
    sample_platform_data_t *dataP;
    uint8_t buffer[1];
    int len;

    dataP = (sample_platform_data_t *)userData;

    if (dataP->sysSocket != -1)
    {
        int sysSock;
        struct sockaddr_in sysAddr, realAddr;

        sysSock = socket(AF_INET, SOCK_DGRAM, IPPROTO_UDP);
        if (sysSock == -1)
        {
            printk("-Failed to create socket: %d\n", errno);
            return;
        }

        memset((char *)& sysAddr, 0, sizeof(sysAddr));

        sysAddr.sin_family = AF_INET;
        sysAddr.sin_port = htons(60000);
        sysAddr.sin_addr.s_addr = htonl((127 << 24) | (0 << 16) | (0 << 8) | 1);

        //bind socket to port
        if (connect(sysSock, (struct sockaddr *) &sysAddr, sizeof(sysAddr)) == -1)
        {
            printk("- Failed to connect socket: %d\n", errno);
            return;
        }

        buffer[0] = 'n';
        send(sysSock, buffer, 1, 0);

        (void)close(sysSock);
    }
}

void iowa_system_mutex_lock(void *userData)
{
    sample_platform_data_t *dataP;

    dataP = (sample_platform_data_t *)userData;

    k_mutex_lock(&(dataP->mutex), K_NO_WAIT);

}

void iowa_system_mutex_unlock(void *userData)
{
    sample_platform_data_t *dataP;

    dataP = (sample_platform_data_t *)userData;

    k_mutex_unlock(&(dataP->mutex));
}

// This is not a proper way to generate a random vector, it only serves as an example here
int iowa_system_random_vector_generator(uint8_t *randomBuffer,
                                        size_t size,
                                        void *userData)
{
    size_t i;

    (void)userData;

    for (i = 0; i < size; i++)
    {
        randomBuffer[i] = rand() % 256;
    }

    return 0;
}
```
